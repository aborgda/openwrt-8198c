// SPDX-License-Identifier: GPL-2.0-or-later OR MIT

#include "rtl8198c.dtsi"

/ {
	compatible = "realtek,rtl8198c-soc";
	model = "SK337";

	/* Verify RAM size and peripheral layout against the board before use. */
	memory@0 {
		device_type = "memory";
		reg = <0x0 0x8000000>;
	};
};
